## sdkconfig.defaults
```kconfig
CONFIG_IDF_TARGET="esp32c3"
CONFIG_ESPTOOLPY_FLASHSIZE_4MB=y
CONFIG_ESPTOOLPY_FLASHSIZE="4MB"
CONFIG_UBRIDGE_UART_PORT_NUM=1
CONFIG_UBRIDGE_UART_BAUD_RATE=115200
CONFIG_UBRIDGE_UART_PARITY_NONE=y
CONFIG_UBRIDGE_UART_RXD=20
CONFIG_UBRIDGE_UART_TXD=21
CONFIG_ESP_CONSOLE_SECONDARY_NONE=y
CONFIG_HTTPD_MAX_REQ_HDR_LEN=2048
# CONFIG_PARTITION_TABLE_SINGLE_APP is not set
CONFIG_PARTITION_TABLE_CUSTOM=y
CONFIG_PARTITION_TABLE_CUSTOM_FILENAME="partitions.csv"
```
